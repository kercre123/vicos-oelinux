## oe/meta-anki/conf/layer.conf
```bitbake
BBFILES += "${LAYERDIR}/recipes*/*/*.bb ${LAYERDIR}/recipes*/*/*.bbappend"
BBPATH .= ":${LAYERDIR}"
BBFILE_COLLECTIONS += "anki"
BBFILE_PRIORITY_anki =  "12"
BBFILE_PATTERN_anki := "^${LAYERDIR}/"
```

## oe/meta-victor-bsp/conf/bblayers.conf.sample
```bitbake
# LAYER_CONF_VERSION is increased each time build/conf/bblayers.conf
# changes incompatibly
LCONF_VERSION = "6"

export WORKSPACE := "##OEROOT##/../.."

BBPATH = "${TOPDIR}"
BBFILES ?= ""


BBLAYERS = " \
##OEROOT##/../meta-victor-bsp/meta-qti-qsap-prop \
##OEROOT##/../meta-victor-bsp/meta-qti-security-prop \
##OEROOT##/../meta-victor-bsp/meta-qti-wlan-prop \
##OEROOT##/../meta-victor-bsp/meta-qti-camera-prop \
##OEROOT##/../meta-victor-bsp/meta-qti-bt-prop \
##OEROOT##/../meta-victor-bsp/meta-qti-wfd-prop \
##OEROOT##/../meta-victor-bsp/meta-qti-video-prop \
##OEROOT##/../meta-victor-bsp/meta-qti-cv-prop/scve \
##OEROOT##/../meta-victor-bsp/meta-qti-cv-prop/fastcv \
##OEROOT##/../meta-victor-bsp/meta-qti-data-prop \
##OEROOT##/../meta-victor-bsp/meta-qti-core-prop \
##OEROOT##/../meta-victor-bsp/meta-qti-drones-prop \
##OEROOT##/../meta-victor-bsp/meta-qti-auto-prop \
##OEROOT##/../meta-victor-bsp/meta-qti-ss-mgr-prop \
##OEROOT##/../meta-victor-bsp/meta-qti-gfx-prop \
##OEROOT##/../meta-victor-bsp/meta-qti-qmmf-prop \
##OEROOT##/../meta-victor-bsp/meta-qti-audio-prop \
##OEROOT##/../meta-victor-bsp/meta-qti-display-prop \
##OEROOT##/../meta-victor-bsp/meta-qti-bsp-prop \
##OEROOT##/../meta-victor-bsp/meta-qti-camera \
##OEROOT##/../meta-victor-bsp/meta-qti-display \
##OEROOT##/../meta-victor-bsp/meta-qti-bt \
##OEROOT##/../meta-victor-bsp/meta-qti-wlan \
##OEROOT##/../meta-victor-bsp/meta-qti-data \
##OEROOT##/../meta-victor-bsp/meta-qti-drones \
##OEROOT##/../meta-victor-bsp/meta-qti-auto \
##OEROOT##/../meta-victor-bsp/meta-qti-qmmf \
##OEROOT##/../meta-victor-bsp/meta-qti-video \
##OEROOT##/../meta-victor-bsp/meta-qti-ss-mgr \
##OEROOT##/../meta-victor-bsp/meta-qti-audio \
##OEROOT##/../meta-victor-bsp/meta-qti-core \
##OEROOT##/../meta-victor-bsp/meta-qti-bsp \
##OEROOT##/../meta-victor-bsp/meta-selinux \
##OEROOT##/../meta-anki \
##OEROOT##/../meta-user-managemement \
##OEROOT##/../meta-victor-bsp/meta-qti-qsap \
##OEROOT##/../meta-vicos-mods \
##OEROOT##/../meta-vicos \
##OEROOT##/meta"
```

## oe/meta-victor-bsp/meta-qti-bsp-prop/conf/machine/apq8009.conf
```bitbake
#@TYPE: Machine
#@NAME: APQ8009
#@DESCRIPTION: Machine configuration for QTI APQ8009

require ${COREBASE}/meta-qti-bsp/conf/machine/apq8009.conf
```

## oe/meta-victor-bsp/meta-qti-bsp-prop/conf/machine/apq8053-32.conf
```bitbake
#@TYPE: Machine
#@NAME: APQ8053-32
#@DESCRIPTION: Machine configuration for QTI APQ8053 32 bit

require ${COREBASE}/meta-qti-bsp/conf/machine/apq8053-32.conf
```

## oe/meta-victor-bsp/meta-qti-bsp-prop/conf/machine/apq8053.conf
```bitbake
#@TYPE: Machine
#@NAME: APQ8053
#@DESCRIPTION: Machine configuration for QTI APQ8053

require ${COREBASE}/meta-qti-bsp/conf/machine/apq8053.conf
```

## oe/meta-victor-bsp/meta-qti-bsp-prop/conf/machine/apq8096.conf
```bitbake
#@TYPE: Machine
#@NAME: APQ8096
#@DESCRIPTION: Machine configuration for QTI APQ8096

require ${COREBASE}/meta-qti-bsp/conf/machine/apq8096.conf
```

## oe/meta-victor-bsp/meta-qti-video-prop/conf/layer.conf
```bitbake
BBFILES += "${LAYERDIR}/recipes/*/*.bb ${LAYERDIR}/recipes/*/*.bbappend ${LAYERDIR}/recipes-*/*/*.bb ${LAYERDIR}/recipes-*/*/*.bbappend"
BBPATH .= ":${LAYERDIR}"
BBFILE_COLLECTIONS += "qcom"
BBFILE_PRIORITY_qcom = "17"
BBFILE_PATTERN_qcom := "^${LAYERDIR}/"
```

## poky/meta-anki/conf/layer.conf
```bitbake
BBFILES += "${LAYERDIR}/recipes/*/*.bb ${LAYERDIR}/recipes/*/*.bbappend ${LAYERDIR}/recipes-*/*/*.bb ${LAYERDIR}/recipes-products/images/*.bbappend"
BBPATH .= ":${LAYERDIR}"
BBFILE_COLLECTIONS += "anki"
BBFILE_PRIORITY_anki =  "12"
BBFILE_PATTERN_anki := "^${LAYERDIR}/"
```

## poky/meta-ddl/conf/layer.conf
```bitbake
# We have a conf and classes directory, add to BBPATH
BBPATH .= ":${LAYERDIR}"

# We have recipes-* directories, add to BBFILES
BBFILES += "${LAYERDIR}/recipes-*/*/*.bb \
	${LAYERDIR}/recipes-*/*/*.bbappend"

BBFILE_COLLECTIONS += "ddl"
BBFILE_PATTERN_ddl = "^${LAYERDIR}/"
BBFILE_PRIORITY_ddl = "13"

IMAGE_INSTALL_append = " nano mg resetrobot"

# Only run localsshuser recipe when the image has local ssh
IMAGE_INSTALL_append += "${@base_conditional('USER_BUILD', '1', '', 'localsshuser', d)}"
IMAGE_INSTALL_append += "${@base_conditional('DEV', '1', 'localsshuser', '', d)}"
```

## poky/meta-qti-auto-prop/conf/layer.conf
```bitbake
BBFILES += "${LAYERDIR}/recipes/*/*.bb ${LAYERDIR}/recipes/*/*.bbappend ${LAYERDIR}/recipes-*/*/*.bb ${LAYERDIR}/recipes-products/images/*.bbappend"
BBPATH .= ":${LAYERDIR}"
BBFILE_COLLECTIONS += "auto-prop"
BBFILE_PRIORITY_auto-prop = "17"
BBFILE_PATTERN_auto-prop := "^${LAYERDIR}/"
```

## poky/meta-qti-bsp-prop/conf/distro/include/security_flags.inc
```bitbake
require ${COREBASE}/meta-qti-bsp/conf/distro/include/security_flags.inc

# GPS Prop packages to use -fPIC in security flags instead of -fpie
SECURITY_CFLAGS_pn-drplugin-client = "${SECURITY_PIC_CFLAGS}"
SECURITY_CFLAGS_pn-drplugin-server = "${SECURITY_PIC_CFLAGS}"
SECURITY_CFLAGS_pn-drplugin = "${SECURITY_PIC_CFLAGS}"
SECURITY_CFLAGS_pn-event-observer = "${SECURITY_PIC_CFLAGS}"
SECURITY_CFLAGS_pn-gdtap-adapter = "${SECURITY_PIC_CFLAGS}"
SECURITY_CFLAGS_pn-izat-core = "${SECURITY_PIC_CFLAGS}"
SECURITY_CFLAGS_pn-izat-client-api = "${SECURITY_PIC_CFLAGS}"
SECURITY_CFLAGS_pn-lbs-core = "${SECURITY_PIC_CFLAGS}"
SECURITY_CFLAGS_pn-loc-base-util = "${SECURITY_PIC_CFLAGS}"
SECURITY_CFLAGS_pn-loc-externaldr = "${SECURITY_PIC_CFLAGS}"
SECURITY_CFLAGS_pn-loc-mq-client = "${SECURITY_PIC_CFLAGS}"
SECURITY_CFLAGS_pn-loc-vzw = "${SECURITY_PIC_CFLAGS}"
SECURITY_CFLAGS_pn-location-flp = "${SECURITY_PIC_CFLAGS}"
SECURITY_CFLAGS_pn-lowi-client  = "${SECURITY_PIC_CFLAGS}"
SECURITY_CFLAGS_pn-slim-client  = "${SECURITY_PIC_CFLAGS}"
SECURITY_CFLAGS_pn-slim-utils  = "${SECURITY_PIC_CFLAGS}"
SECURITY_CFLAGS_pn-ulp2  = "${SECURITY_PIC_CFLAGS}"
SECURITY_CFLAGS_pn-loc-glue  = "${SECURITY_PIC_CFLAGS}"
SECURITY_CFLAGS_pn-loc-hal-test-shim  = "${SECURITY_PIC_CFLAGS}"
SECURITY_CFLAGS_pn-location-service  = "${SECURITY_PIC_CFLAGS}"
SECURITY_CFLAGS_pn-data-items  = "${SECURITY_PIC_CFLAGS}"

# Anki
SECURITY_CFLAGS_pn-ankibluetoothd = "${SECURITY_PIE_CFLAGS}"
```

## poky/meta-qti-bsp-prop/conf/machine/apq8009-qsap.conf
```bitbake
#@TYPE: Machine
#@NAME: APQ8009 MTP
#@DESCRIPTION: Machine configuration for QTI MTP with APQ8009

require ${COREBASE}/meta-qti-bsp/conf/machine/apq8009-qsap.conf
```

## poky/meta-qti-bsp-prop/conf/machine/apq8017.conf
```bitbake
#@TYPE: Machine
#@NAME: APQ8017
#@DESCRIPTION: Machine configuration for QTI APQ8017

require ${COREBASE}/meta-qti-bsp/conf/machine/apq8017.conf
```

## poky/meta-qti-bsp-prop/conf/machine/apq8053.conf
```bitbake
#@TYPE: Machine
#@NAME: APQ8053
#@DESCRIPTION: Machine configuration for QTI APQ8053

require ${COREBASE}/meta-qti-bsp/conf/machine/apq8053.conf

USRFS_FSCONFIG = "-C ${WORKDIR}/usrfs_fsconfig.conf"
PERSISTFS_CONFIG = "-C ${WORKDIR}/persist_fsconfig.conf"
MAKEEXT4_MOUNT_OPT = "-a /"
```

## poky/meta-qti-bsp-prop/conf/machine/apq8096-excelsior.conf
```bitbake
#@TYPE: Machine
#@NAME: APQ8096-EXCELSIOR
#@DESCRIPTION: Machine configuration for QTI with APQ8096 EXCELSIOR

require ${COREBASE}/meta-qti-bsp/conf/machine/apq8096-excelsior.conf
```

## poky/meta-qti-bsp-prop/conf/machine/apq8098.conf
```bitbake
#@TYPE: Machine
#@NAME: APQ8098
#@DESCRIPTION: Machine configuration for QTI APQ8098

require ${COREBASE}/meta-qti-bsp/conf/machine/apq8098.conf
```

## poky/meta-qti-bsp-prop/conf/machine/mdm9650-2k.conf
```bitbake
#@TYPE: Machine
#@NAME: MDM9650-2K
#@DESCRIPTION: Machine configuration for MDM9650 with 2K NAND

require ${COREBASE}/meta-qti-bsp/conf/machine/mdm9650-2k.conf

# Pull in the security flags overrides for prop packages
require ${COREBASE}/meta-qti-bsp-prop/conf/distro/include/security_flags.inc
```

## poky/meta-qti-bsp/conf/distro/include/msm.inc
```bitbake
#############################################################################
#@COMMENT: This distribution configuration defines an OE Linux based
#@COMMENT: distribution. The matching buildable image target (machine-image)
#@COMMENT: basically consists of: libc, busybox, udev, sysv init, and a few
#@COMMENT: init scripts for running up the system on qti chipsets.
#############################################################################

# DISTRO FEATURE SELECTION
MICRO_GOLD = "ld-is-gold"

USE_DEVFS = "0"

# Use Debian naming scheme for library (.so) files
INHERIT += "recipe_sanity"

# TOOLCHAIN
PREFERRED_VERSION_autoconf = "2.68"
ARM_INSTRUCTION_SET       ?= "arm"

FULL_OPTIMIZATION          = "-O2 -Wa,--noexecstack -fstack-protector -fexpensive-optimizations -frename-registers -fomit-frame-pointer -ftree-vectorize "
FULL_OPTIMIZATION         += " -finline-functions -finline-limit=64 "
# Ignore a few common warnings
FULL_OPTIMIZATION         += " -Wno-error=maybe-uninitialized -Wno-error=unused-result "

# These flags are taken from android build tree and can be used by recipes if needed.

OPTIONAL_CFLAGS = "-fstack-protector -fdata-sections -funwind-tables -Wa,--noexecstack  -Wformat  -Werror=format-security -D_FORTIFY_SOURCE=2  -fno-short-enums -no-canonical-prefixes -Wno-error=return-type"
OPTIONAL_CFLAGS += " -fmessage-length=0 -DNDEBUG -UDEBUG -Wno-error=unused-result -Wno-error=attributes -Wno-error=uninitialized -Wno-error=unused-variable -Wno-error=unused-parameter -Wno-error=builtin-macro-redefined -Wno-error=type-limits -Wno-error=unused-but-set-variable "
THUMB_FLAGS = " -Os -mthumb "
OPTIONAL_LDFLAGS = "-Wl,-z,noexecstack -Wl,-z,relro -Wl,-z,now -Wl,--warn-shared-textrel -Wl,--fatal-warnings "

# NLS
USE_NLS = "no"
USE_NLS_glib-2.0 = "yes"
USE_NLS_glib-2.0-native = "yes"
USE_NLS_gcc-cross = "no"

# Disable binary locale generation
ENABLE_BINARY_LOCALE_GENERATION = "0"

#Allow library symlinks to exist alongside soname files
PACKAGE_SNAP_LIB_SYMLINKS = "0"

# Don't install ldconfig and associated gubbins
USE_LDCONFIG = "0"
LDCONFIGDEPEND = ""
COMMERCIAL_LICENSE_DEPENDEES = ""

# Add the yaffs2 imaging commands to the filesystem support for Bitbake as
# OE-Core doesn't support them directly...
IMAGE_CMD_yaffs2 = "mkyaffs2image ${EXTRA_IMAGECMD} ${IMAGE_ROOTFS} ${DEPLOY_DIR_IMAGE}/${IMAGE_NAME}.rootfs.yaffs2; chmod 644 ${DEPLOY_DIR_IMAGE}/${IMAGE_NAME}.rootfs.yaffs2"

# fastboot imaging commands
IMAGE_DEPENDS_fastboot = "mkbootimg-native virtual/kernel"
IMAGE_CMD_fastboot = "${STAGING_BINDIR_NATIVE}/mkbootimg --kernel ${STAGING_DIR_TARGET}/kernel/arch/arm/boot/Image --ramdisk /dev/null --ramdisk_offset $(awk --non-decimal-data '/ _end/ {end="0x" $1} /_stext/ {beg="0x" $1} END {size1=end-beg+4096; size=and(size1,compl(4095)); printf("%#x",size)}' ${STAGING_DIR_TARGET}/boot/System.map-${MACHINE_KERNEL_VERSION}) --cmdline 'root=${MACHINE_ROOTDEV} rw init=/sbin/init --verbose loglevel=7 rootwait console=${MACHINE_CONSOLE} no_console_suspend=1 androidboot.hardware=qcom log_buf_len=262144' --base ${MACHINE_KERNEL_BASE} ${EXTRA_IMAGECMD} --pagesize ${MACHINE_FLASH_PAGE_SIZE} --output ${DEPLOY_DIR_IMAGE}/${IMAGE_NAME}.rootfs.fastboot"

PREFERRED_VERSION_readline = "5.2"

EXTRA_USERS_PARAMS = "\
 useradd -u 1000 -U system; \
 useradd -u 1001 -U radio; \
 useradd -u 1002 -U bluetooth; \
 useradd -u 1003 -U graphics; \
 useradd -u 1004 -g input input; \
 useradd -u 1005 -g audio audio; \
 useradd -u 1006 -U camera;\
 useradd -u 1036 -U logd;\
 useradd -u 2000 -U adb; \
 useradd -u 3011 -U sensors; \
 useradd -u 4000 -U apps; \
 useradd -u 9999 -U nobody; \
 useradd -u 5000 -U qmmfsvr; \
 useradd -u 5001 -U qmmfwebsvr; \
 useradd -u 5002 -U leprop; \
 usermod -L -e 1 system; \
 usermod -L -e 1 radio; \
 usermod -L -e 1 bluetooth; \
 usermod -L -e 1 graphics; \
 usermod -L -e 1 input; \
 usermod -L -e 1 audio; \
 usermod -L -e 1 camera; \
 usermod -L -e 1 adb; \
 usermod -L -e 1 sensors; \
 usermod -L -e 1 Apps; \
 usermod -L -e 1 nobody; \
 usermod -L -e 1 qmmfsvr; \
 usermod -L -e 1 qmmfwebsvr; \
 usermod -L -e 1 leprop; \
 usermod -L -e 1 logd; \
 usermod -a -G system,inet,leprop qmmfwebsvr; \
 usermod -a -G system,leprop qmmfsvr; \
 usermod -a -G diag,inet,system,leprop sensors; \
 usermod -a -G inet,system,leprop camera; \
 usermod -a -G leprop bluetooth; \
"
```

## poky/meta-qti-bsp/conf/distro/include/security_flags.inc
```bitbake
# Pull in the default security flags
require ${COREBASE}/meta/conf/distro/include/security_flags.inc

# Modify the primary security flag definitions
SECURITY_CFLAGS = "-fstack-protector-strong -pie -fpie -Wa,--noexecstack"
SECURITY_PIC_CFLAGS = "-fstack-protector-strong -fPIC -Wa,--noexecstack"
SECURITY_LDFLAGS = "-Wl,-z,relro,-z,now,-z,noexecstack"

# GPS OSS packages to use -fPIC in security flags instead of -fpie
SECURITY_CFLAGS_pn-loc-hal = "${SECURITY_PIC_CFLAGS}"
SECURITY_CFLAGS_pn-loc-pla = "${SECURITY_PIC_CFLAGS}"
SECURITY_CFLAGS_pn-loc-stub = "${SECURITY_PIC_CFLAGS}"
SECURITY_CFLAGS_pn-gps-utils = "${SECURITY_PIC_CFLAGS}"
SECURITY_CFLAGS_pn-loc-net-iface = "${SECURITY_PIC_CFLAGS}"

# packages to use -fPIC in security flags instead of -fpie
SECURITY_CFLAGS_pn-gtest = "${SECURITY_PIC_CFLAGS}"
SECURITY_CFLAGS_pn-libcutils  = "${SECURITY_PIC_CFLAGS}"
SECURITY_CFLAGS_pn-liblog  = "${SECURITY_PIC_CFLAGS}"

# libutils to use -fPIC in security flags instead of -fpie
SECURITY_CFLAGS_pn-system-core = "${SECURITY_PIC_CFLAGS}"

# libbinder to use -fPIC in security flags instead of -fpie
SECURITY_CFLAGS_pn-native-frameworks  = "${SECURITY_PIC_CFLAGS}"

# BT OSS packages to use -fPIC in security flags instead of -fpie
SECURITY_CFLAGS_pn-bt-property = "${SECURITY_PIC_CFLAGS}"
SECURITY_CFLAGS_pn-bt-app = "${SECURITY_PIC_CFLAGS}"
SECURITY_CFLAGS_pn-libbt-vendor = "${SECURITY_PIC_CFLAGS}"
SECURITY_CFLAGS_pn-fluoride = "${SECURITY_PIC_CFLAGS}"
```

## poky/meta-qti-qmmf-prop/conf/layer.conf
```bitbake
BBFILES += "${LAYERDIR}/recipes/*/*.bb ${LAYERDIR}/recipes/*/*.bbappend ${LAYERDIR}/recipes-*/*/*.bb ${LAYERDIR}/recipes-*/*/*.bbappend"
BBPATH .= ":${LAYERDIR}"
BBFILE_COLLECTIONS += "qmmf-prop"
BBFILE_PRIORITY_qmmf-prop = "17"
BBFILE_PATTERN_qmmf-prop := "^${LAYERDIR}/"
```

## poky/meta-qti-security-prop/conf/layer.conf
```bitbake
BBFILES += "${LAYERDIR}/recipes/*/*.bb ${LAYERDIR}/recipes/*/*.bbappend ${LAYERDIR}/recipes-*/*/*.bb ${LAYERDIR}/recipes-*/*/*.bbappend"
BBPATH .= ":${LAYERDIR}"
BBFILE_COLLECTIONS += "qti-sec"
BBFILE_PRIORITY_qti-sec = "17"
BBFILE_PATTERN_qti-sec := "^${LAYERDIR}/"
```
